## config/west.yml
```yaml
manifest:
  remotes:
    - name: zmkfirmware
      url-base: https://github.com/zmkfirmware
    - name: badjeff
      url-base: https://github.com/badjeff

  projects:
    - name: zmk
      remote: zmkfirmware
      revision: main                # <-- исправлено: тег v0.4.1 вместо несуществующей ветки
      import: app/west.yml
    - name: zmk-pmw3610-driver
      remote: badjeff
      revision: main
      path: zmk-modules/pmw3610-driver
    - name: zmk-split-peripheral-input-relay
      remote: badjeff
      revision: main
      path: zmk-modules/split-peripheral-input-relay
    - name: zmk-input-behavior-listener
      remote: badjeff
      revision: main
      path: zmk-modules/input-behavior-listener

  self:
    path: config
```
